## main/Kconfig.projbuild
```kconfig
menu "UM Series[D] Board Configuration"

    choice
        prompt "Select UM Series[D] board"
        default UM_BOARD_PROS3
        config UM_BOARD_FEATHERS3
            bool "FeatherS3"
        config UM_BOARD_PROS3
            bool "ProS3"
        config UM_BOARD_TINYS3
            bool "TinyS3"
        config UM_BOARD_EDGES3D
            bool "EdgeS3D"
    endchoice

    config UM_LDO2_PIN
        int
        default 17 if UM_BOARD_PROS3
        default 39 if UM_BOARD_FEATHERS3

    config UM_RGB_PWR_PIN
        int
        default UM_LDO2_PIN if UM_BOARD_PROS3
        default UM_LDO2_PIN if UM_BOARD_FEATHERS3
        default 17 if UM_BOARD_TINYS3

    config UM_RGB_DATA_PIN
        int
        default 18 if UM_BOARD_PROS3
        default 40 if UM_BOARD_FEATHERS3
        default 18 if UM_BOARD_TINYS3

    config UM_I2C_SDA_PIN
        int
        default 8 if UM_BOARD_PROS3
        default 8 if UM_BOARD_FEATHERS3
        default 8 if UM_BOARD_TINYS3
        default 8 if UM_BOARD_EDGES3D

    config UM_I2C_SCL_PIN
        int
        default 9 if UM_BOARD_PROS3
        default 9 if UM_BOARD_FEATHERS3
        default 9 if UM_BOARD_TINYS3
        default 9 if UM_BOARD_EDGES3D

    config UM_VBUS_SENSE_PIN
        int
        default 33 if UM_BOARD_PROS3
        default 34 if UM_BOARD_FEATHERS3
        default 33 if UM_BOARD_TINYS3

    config UM_LED_BUILTIN_PIN
        int
        default 13 if UM_BOARD_FEATHERS3

    config UM_ANTENNA_EXTERNAL
        bool "Use external antenna (RF switch high)"
        default false
        help
            If enabled, sets the RF switch to use the external antenna. If disabled, uses the onboard antenna.

endmenu

menu "Echo Example Configuration"

    orsource "$IDF_PATH/examples/common_components/env_caps/$IDF_TARGET/Kconfig.env_caps"

    config EXAMPLE_UART_PORT_NUM
        int "UART port number"
        range 0 2 if IDF_TARGET_ESP32 || IDF_TARGET_ESP32S3
        default 0 if IDF_TARGET_ESP32 || IDF_TARGET_ESP32S3
        range 0 1
        default 1
        help
            UART communication port number for the example.
            See UART documentation for available port numbers.

    config EXAMPLE_UART_BAUD_RATE
        int "UART communication speed"
        range 1200 115200
        default 115200
        help
            UART communication speed for Modbus example.

    config EXAMPLE_UART_RXD
        int "UART RXD pin number"
        range ENV_GPIO_RANGE_MIN ENV_GPIO_IN_RANGE_MAX
        default 5
        help
            GPIO number for UART RX pin. See UART documentation for more information
            about available pin numbers for UART.

    config EXAMPLE_UART_TXD
        int "UART TXD pin number"
        range ENV_GPIO_RANGE_MIN ENV_GPIO_OUT_RANGE_MAX
        default 4
        help
            GPIO number for UART TX pin. See UART documentation for more information
            about available pin numbers for UART.

    config EXAMPLE_TASK_STACK_SIZE
        int "UART echo example task stack size"
        range 1024 16384
        default 3072
        help
            Defines stack size for UART echo example. Insufficient stack size can cause crash.

endmenu

menu "Wi-Fi Access Point Settings"
    config WIFI_AP_SSID
        string "Wi-Fi AP SSID"
        default "ESP32_AP"

    config WIFI_AP_CHANNEL
        int "Wi-Fi AP Channel"
        range 1 13
        default 6

    config WIFI_AP_MAX_CONN
        int "Max Connections"
        range 1 10
        default 4

    choice
        prompt "Wi-Fi AP Auth Mode"
        default WIFI_AUTH_OPEN
        config WIFI_AUTH_OPEN
            bool "Open (no password)"
        config WIFI_AUTH_WPA_PSK
            bool "WPA-PSK"
        config WIFI_AUTH_WPA2_PSK
            bool "WPA2-PSK"
        config WIFI_AUTH_WPA_WPA2_PSK
            bool "WPA/WPA2-PSK"
    endchoice

    config WIFI_AP_PASSWORD
        string "Wi-Fi AP Password (if required)"
        default ""

endmenu

menu "Ultrasonic Distance Sensor"
    config ULTRASONIC_TRIG_GPIO
        int "Trigger (TX) GPIO pin"
        range ENV_GPIO_RANGE_MIN ENV_GPIO_OUT_RANGE_MAX
        default 36
        help
            GPIO pin to use for the ultrasonic TRIG (TX) output. Default is 36.

    config ULTRASONIC_ECHO_GPIO
        int "Echo (RX) GPIO pin"
        range ENV_GPIO_RANGE_MIN ENV_GPIO_IN_RANGE_MAX
        default 34
        help
            GPIO pin to use for the ultrasonic ECHO (RX) input. Default is 34.

    config ULTRASONIC_RMT_RESOLUTION_HZ
        int "RMT tick resolution (Hz)"
        default 17143
        help
            RMT resolution in Hz. 17143 gives ~58.333 µs ticks (1 tick ≈ 1 cm). For higher
            precision use 1000000 (1 µs ticks).

    config ULTRASONIC_TRIGGER_PULSE_US
        int "Trigger pulse width (µs)"
        default 10
        help
            Duration of the trigger pulse in microseconds (default 10 µs).

    config ULTRASONIC_TRIGGER_INTERVAL_MS
        int "Trigger interval (ms)"
        default 100
        help
            Minimum time between trigger pulses in milliseconds.

    config ULTRASONIC_SIGNAL_RANGE_MIN_CM
        int "Minimum distance (cm)"
        default 3
        help
            Minimum reliable distance in centimeters. Used to compute RMT receive min signal.

    config ULTRASONIC_SIGNAL_RANGE_MAX_CM
        int "Maximum distance (cm)"
        default 250
        help
            Maximum reliable distance in centimeters. Used to compute RMT receive stop signal.

    config ULTRASONIC_RMT_MEM_BLOCK_SYMBOLS
        int "RMT memory block size (symbols)"
        default 64
        help
            Number of RMT symbols to allocate for RX buffering. Increase for long frames.

    choice
        prompt "Ultrasonic filter type"
        default ULTRASONIC_FILTER_MEDIAN
        config ULTRASONIC_FILTER_NONE
            bool "None"
        config ULTRASONIC_FILTER_MEDIAN
            bool "Median"
        config ULTRASONIC_FILTER_AVG
            bool "Moving average"
        config ULTRASONIC_FILTER_EWMA
            bool "EWMA (exponential)"
    endchoice

    # Per-filter parameter fields: each only appears when its corresponding filter is selected.
    config ULTRASONIC_FILTER_PARAM_MEDIAN
        int "Filter parameter (median window)"
        depends on ULTRASONIC_FILTER_MEDIAN
        default 3
        help
            Median filter window size (odd number recommended).

    config ULTRASONIC_FILTER_PARAM_AVG
        int "Filter parameter (moving average window)"
        depends on ULTRASONIC_FILTER_AVG
        default 3
        help
            Moving average window size. Larger values increase smoothing and latency.

    config ULTRASONIC_FILTER_PARAM_EWMA
        int "Filter parameter (EWMA alpha * 100)"
        depends on ULTRASONIC_FILTER_EWMA
        range 1 99
        default 20
        help
            EWMA alpha times 100 (e.g., 20 => 0.20). Lower values increase smoothing.

    config ULTRASONIC_TIMEOUT_MS
        int "Echo timeout (ms)"
        default 50
        help
            Maximum time to wait for an echo in milliseconds before timing out.

endmenu

menu "Wi-Fi Station (STA) Settings"
    config WIFI_STA_SSID
        string "Wi-Fi STA SSID"
        default "TMOBILE-E178"

    config WIFI_STA_PASSWORD
        string "Wi-Fi STA Password"
        default "YourPassword"
endmenu

menu "Dispatcher Pool Test"
    config DISPATCHER_POOL_TEST
        bool "Enable dispatcher pool test module"
        default n
        help
            Enables a test module that sends/receives pointer messages using dispatcher_pool.
endmenu
```
